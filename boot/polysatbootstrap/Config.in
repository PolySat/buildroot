## boot/polysatbootstrap/Config.in
```kconfig
config BR2_TARGET_POLYSATBOOTSTRAP
	depends on BR2_arm926t
	depends on BR2_TARGET_SEPARATE_USR_LOCAL
	bool "PolySat Intrepid Bootstrap"
	help
	  PolySat Bootstrap is a custom first level bootloader for the
          Atmel AT91-based PolySat boards.  It is based on the AT91 Bootstrap
          with added features for kernel and initrd validation prior to boot.

choice
   prompt "version"
   depends on BR2_TARGET_POLYSATBOOTSTRAP
   default BR2_TARGET_POLYSATBOOTSTRAP_version_head
   help
      The git version of the code to use

   config BR2_TARGET_POLYSATBOOTSTRAP_version_custom
      bool "Specify a custom git tag"

   config BR2_TARGET_POLYSATBOOTSTRAP_version_head
      bool "HEAD"

endchoice

config BR2_TARGET_POLYSATBOOTSTRAP_CONFIG_CUSTOM_VERSION_STR
   string "PolySat bootstrap version"
   depends on BR2_TARGET_POLYSATBOOTSTRAP
   depends on BR2_TARGET_POLYSATBOOTSTRAP_version_custom
   help
      Custom git tag to build.
```

## fs/Config.in
```kconfig
menu "Filesystem images"

config BR2_TARGET_SEPARATE_USR_LOCAL
        bool "Separate /usr/local"
        help
          Split the root fs image into two pieces: / and /usr/local.


source "fs/cramfs/Config.in"
source "fs/cloop/Config.in"
source "fs/ext2/Config.in"
source "fs/jffs2/Config.in"
source "fs/ubifs/Config.in"
source "fs/squashfs/Config.in"
source "fs/tar/Config.in"
source "fs/cpio/Config.in"
source "fs/iso9660/Config.in"
source "fs/initramfs/Config.in"
source "fs/romfs/Config.in"

endmenu
```

## fs/cloop/Config.in
```kconfig
config BR2_TARGET_ROOTFS_CLOOP
	bool "cloop root filesystem for the target device"
	help
	  Build a cloop root filesystem

	  cloop is a Linux kernel module that enables compressed
	  loopback filesystem support. With it you can mount a
	  compressed filesystem like a block device and seamlessly
	  decompress its data while accessing it.  The majority of the
	  software on an LNX-BBC is accessed in this fashion.

config BR2_TARGET_USR_LOCAL_CLOOP
	bool "cloop /usr/local filesystem for the target device"
	depends on BR2_TARGET_SEPARATE_USR_LOCAL
	help
	  Build a cloop /usr/local filesystem

	  cloop is a Linux kernel module that enables compressed
	  loopback filesystem support. With it you can mount a
	  compressed filesystem like a block device and seamlessly
	  decompress its data while accessing it.  The majority of the
	  software on an LNX-BBC is accessed in this fashion.
```

## fs/cramfs/Config.in
```kconfig
config BR2_TARGET_ROOTFS_CRAMFS
	bool "cramfs root filesystem"
	help
	  Build a cramfs root filesystem

	  http://sourceforge.net/projects/cramfs/

config BR2_TARGET_USR_LOCAL_CRAMFS
	bool "cramfs /usr/local filesystem"
	depends on BR2_TARGET_SEPARATE_USR_LOCAL
	help
	  Build a cramfs /usr/local filesystem

	  http://sourceforge.net/projects/cramfs/
```

## fs/romfs/Config.in
```kconfig
config BR2_TARGET_ROOTFS_ROMFS
	bool "romfs root filesystem"
	help
	  Build a romfs image of the root filesystem.

config BR2_TARGET_USR_LOCAL_ROMFS
	bool "romfs /usr/local filesystem"
	depends on BR2_TARGET_SEPARATE_USR_LOCAL
	help
	  Build a romfs image of the /usr/local filesystem.
```

## package/Config.in.host
```kconfig
menu "Host utilities"

source "package/lcm/Config.in.host"
source "package/lpc3250loader/Config.in.host"
source "package/openocd/Config.in.host"
source "package/intrepid-sam-ba/Config.in.host"
source "package/sam-ba/Config.in.host"
source "package/sourcery-codebench/Config.in.host"
source "package/uboot-tools/Config.in.host"

endmenu
```

## package/blas/Config.in
```kconfig
config BR2_PACKAGE_BLAS
	bool "blas"
	help
	  BLAS fortran library

	  http://www.netlib.org/blas
```

## package/cblas/Config.in
```kconfig
config BR2_PACKAGE_CBLAS
	bool "cblas"
	help
	  BLAS c library

	  http://www.netlib.org/blas
```

## package/cpio/Config.in
```kconfig
config BR2_PACKAGE_CPIO
	bool "cpio"
	help
	  Complete GNU cpio implementation.

	  http://www.gnu.org/software/cpio/
```

## package/cpulimit/Config.in
```kconfig
config BR2_PACKAGE_CPULIMIT
	bool "cpulimit"
	depends on BR2_USE_MMU
	help
	  Utility to roughly limit the CPU usage of a particular process

	  https://github.com/opsengine/cpulimit
```

## package/epeg/Config.in
```kconfig
config BR2_PACKAGE_EPEG
	bool "epeg"
	select BR2_PACKAGE_JPEG
	select BR2_PACKAGE_LIBEXIF

	help
	  Insanely fast JPEG/ JPG thumbnail scaling with the minimum fuss and CPU overhead.
	  It makes use of libjpeg features of being able to load an image by only decoding the DCT coefficients needed to reconstruct an image of the size desired.
```

## package/fs_customizations/Config.in
```kconfig
choice
	prompt "Additional root file system files"
	help
	  Add, replace, or remove buildroot generated files based on
	  none       do not customize buildroot's output
	  polysat    use PolySat's root file system template for customization
	  folder     use the files found in a local folder for customization

config BR2_PACKAGE_FS_CUSTOMIZATION_NONE
	bool "none"
	help
	  none       do not customize buildroot's output

config BR2_PACKAGE_FS_CUSTOMIZATION_FOLDER
	bool "folder"
	help
	  folder     use the files found in a local folder for customization
endchoice

config BR2_PACKAGE_FS_CUSTOMIZATION_PATH
	depends on BR2_PACKAGE_FS_CUSTOMIZATION_FOLDER
	string "path to folder"
	help
	  The filesystem path to the folder containing the root fs
	  customization.
```

## package/gmic/Config.in
```kconfig
config BR2_PACKAGE_GMIC
	bool "gmic"
	help
	  Graphics tools and converters

	  http://gmic.sourceforge.net/
```

## package/inetutils/Config.in
```kconfig
config BR2_PACKAGE_INETUTILS
	bool "inetutils - GNU Internet Utilities"
	help
	  netutils is a collection of common network programs.

	  http://www.gnu.org/software/inetutils/

config BR2_PACKAGE_INETUTILS_FTP
	bool "ftp"
	depends on BR2_PACKAGE_INETUTILS
	help
            Installs ftp from the inetutils package

config BR2_PACKAGE_INETUTILS_FTPD
	bool "ftpd"
	depends on BR2_PACKAGE_INETUTILS
	help
            Installs ftpd from the inetutils package

config BR2_PACKAGE_INETUTILS_INETD
	bool "inetd"
	depends on BR2_PACKAGE_INETUTILS
	help
            Installs inetd from the inetutils package

config BR2_PACKAGE_INETUTILS_RCP
	bool "rcp"
	depends on BR2_PACKAGE_INETUTILS
	help
            Installs rcp from the inetutils package

config BR2_PACKAGE_INETUTILS_REXEC
	bool "rexec"
	depends on BR2_PACKAGE_INETUTILS
	help
            Installs rexec from the inetutils package

config BR2_PACKAGE_INETUTILS_REXECD
	bool "rexecd"
	depends on BR2_PACKAGE_INETUTILS
	help
            Installs rexecd from the inetutils package

config BR2_PACKAGE_INETUTILS_RLOGIN
	bool "rlogin"
	depends on BR2_PACKAGE_INETUTILS
	help
            Installs rlogin from the inetutils package

config BR2_PACKAGE_INETUTILS_RSH
	bool "rsh"
	depends on BR2_PACKAGE_INETUTILS
	help
            Installs rsh from the inetutils package

config BR2_PACKAGE_INETUTILS_TELNET
	bool "telnet"
	depends on BR2_PACKAGE_INETUTILS
	help
            Installs telnet from the inetutils package

config BR2_PACKAGE_INETUTILS_TELNETD
	bool "telnetd"
	depends on BR2_PACKAGE_INETUTILS
	help
            Installs telnetd from the inetutils package

config BR2_PACKAGE_INETUTILS_TFTP
	bool "tftp"
	depends on BR2_PACKAGE_INETUTILS
	help
            Installs tftp from the inetutils package

config BR2_PACKAGE_INETUTILS_TFTPD
	bool "tftpd"
	depends on BR2_PACKAGE_INETUTILS
	help
            Installs tftpd from the inetutils package
```

## package/intrepid-sam-ba/Config.in.host
```kconfig
config BR2_PACKAGE_HOST_INTREPID_SAM_BA
	bool "host sam-ba for use with Intrepid board"
	select BR2_PACKAGE_HOST_SOURCERY_CODEBENCH
	help
	  Customized version of Atmel's SAM-BA software the provides the
          ability to program intrepid system boards.
```

## package/jasper/Config.in
```kconfig
config BR2_PACKAGE_JASPER
	bool "JasPer"
	help
		JASPER - A j2k library

		JasPer

		http://www.ece.uvic.ca/~frodo/jasper/
```

## package/jfs-tools/Config.in
```kconfig
config BR2_PACKAGE_JFS_TOOLS
	bool "JFS Tools"
	# uses fork()
	depends on BR2_USE_MMU
	help
	  Userspace tools to manage JFS partitions

	  http://jfs.sourceforge.net
```

## package/lapack/Config.in
```kconfig
config BR2_PACKAGE_LAPACK
	bool "lapack"
	help
	  Linear Algebra Package

	  http://www.netlib.org/lapack
```

## package/lcm/Config.in.host
```kconfig
config BR2_PACKAGE_HOST_LCM
	bool "host LCM"
        select BR2_PACKAGE_HOST_LIBGLIB2
	help
	  LCM - Lightweight Communications and Marshalling

	  https://lcm.googlecode.com/
```

## package/libpgf/Config.in
```kconfig
config BR2_PACKAGE_LIBPGF
	bool "libpgf"
	help
	  PGF image format.

	  http://www.libpgf.org
```

## package/meschach/Config.in
```kconfig
config BR2_PACKAGE_MESCHACH
	bool "meschach"
	help
	  A library for matrix operations written in C

	  http://homepage.math.uiowa.edu/~dstewart/meschach/
```

## package/netpbm/Config.in
```kconfig
config BR2_PACKAGE_NETPBM
	bool "netpbm"
	help
	  Graphics tools and converters

	  http://www.netperf.org/
```

## package/octave/Config.in
```kconfig
config BR2_PACKAGE_OCTAVE
	bool "octave"
   select BR2_PACKAGE_PCRE
	help
	  Octave MatLab replacement

	  http://www.gnu.org/software/octave/
```

## package/openjpeg/Config.in
```kconfig
config BR2_PACKAGE_OPENJPEG
	bool "jpeg 2k"
   select host-cmake
	help
	  An opensource implementation of the Jpeg2000 standard (jpeg2k)

	  http://www.openjpeg.org
```

## package/polysat/Config.in
```kconfig
menu "PolySat Packages"

source "package/polysat/polysat_fsw/Config.in"
source "package/polysat/fsw_image/Config.in"
source "package/polysat/example_image/Config.in"
source "package/polysat/librohc/Config.in"
source "package/polysat/atmel-isi/Config.in"
source "package/polysat/uvccapture/Config.in"
source "package/polysat/ade_pib_driver/Config.in"
source "package/polysat/submodule_image/Config.in"
source "package/polysat/beacon/Config.in"
source "package/polysat/ade_payload/Config.in"

endmenu
```
