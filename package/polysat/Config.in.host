## package/polysat/ade_payload/Config.in
```kconfig
config BR2_PACKAGE_ADE_PAYLOAD
    bool "ADE Payload process"
    help
        Manages the payload for the ADE mission

choice
   prompt "source code version"
   depends on BR2_PACKAGE_ADE_PAYLOAD
   default BR2_PACKAGE_ADE_PAYLOAD_version_head
   help
        The version number of the code to install.

   config BR2_PACKAGE_ADE_PAYLOAD_version_head
      bool "HEAD"

   config BR2_PACKAGE_ADE_PAYLOAD_version_custom
      bool "Manual git version"

endchoice

choice
   prompt "install location"
   depends on BR2_PACKAGE_ADE_PAYLOAD
   default BR2_PACKAGE_ADE_PAYLOAD_location_nandsecondary
   help
        Where the driver gets installed

   config BR2_PACKAGE_ADE_PAYLOAD_location_secondary
      bool "NAND"

   config BR2_PACKAGE_ADE_PAYLOAD_location_initrd
      bool "PCM"

endchoice

config BR2_PACKAGE_ADE_PAYLOAD_CONFIG_CUSTOM_VERSION_STR
   string "payload source code version"
   depends on BR2_PACKAGE_ADE_PAYLOAD_version_custom
   help
      Custom git tag to build.
```

## package/polysat/ade_pib_driver/Config.in
```kconfig
config BR2_PACKAGE_ADE_PIB_DRIVER
    bool "ADE PIB Board Driver"
    help
        Provides driver(s) necessary for ADE PIB board

choice
   prompt "source code version"
   depends on BR2_PACKAGE_ADE_PIB_DRIVER
   default BR2_PACKAGE_ADE_PIB_DRIVER_version_head
   help
        The version number of the code to install.

   config BR2_PACKAGE_ADE_PIB_DRIVER_version_head
      bool "HEAD"

   config BR2_PACKAGE_ADE_PIB_DRIVER_version_custom
      bool "Manual git version"

endchoice

choice
   prompt "install location"
   depends on BR2_PACKAGE_ADE_PIB_DRIVER
   default BR2_PACKAGE_ADE_PIB_DRIVER_location_nandsecondary
   help
        Where the driver gets installed

   config BR2_PACKAGE_ADE_PIB_DRIVER_location_secondary
      bool "NAND"

   config BR2_PACKAGE_ADE_PIB_DRIVER_location_initrd
      bool "PCM"

endchoice

config BR2_PACKAGE_ADE_PIB_DRIVER_CONFIG_CUSTOM_VERSION_STR
   string "driver source code version"
   depends on BR2_PACKAGE_ADE_PIB_DRIVER_version_custom
   help
      Custom git tag to build.
```

## package/polysat/atmel-isi/Config.in
```kconfig
config BR2_PACKAGE_ATMEL_ISI
    bool "PolySat Atmel ISI Driver"
    help
        PolySat's customized version of the Atmel ISI driver

choice
   prompt "Atmel ISI driver version"
   depends on BR2_PACKAGE_ATMEL_ISI
   default BR2_PACKAGE_ATMEL_ISI_version_head
   help
      The git version of the atmel-isi driver to use

   config BR2_PACKAGE_ATMEL_ISI_version_head
      bool "HEAD"

   config BR2_PACKAGE_ATMEL_ISI_version_custom
      bool "Manually specify git tag"

endchoice

config BR2_PACKAGE_ATMEL_ISI_CONFIG_CUSTOM_VERSION_STR
   string "Atmel ISI drivers git tag"
   depends on BR2_PACKAGE_ATMEL_ISI
   depends on BR2_PACKAGE_ATMEL_ISI_version_custom
   help
      Custom git tag to build.
```

## package/polysat/beacon/Config.in
```kconfig
config BR2_PACKAGE_BEACON
    bool "beacon"
    select BR2_PACKAGE_LIBSATPKT
    select BR2_PACKAGE_LIBPROC
    help
        Process that periodically generates a beacon packet.

choice
   prompt "Beacon Source Version"
   default BR2_PACKAGE_BEACON_version_1_19
   help
      The git version of the beacon code to use

   config BR2_PACKAGE_BEACON_version_head
      bool "HEAD"

   config BR2_PACKAGE_BEACON_version_custom
      bool "Manually specify a git tag to build"

   config BR2_PACKAGE_BEACON_version_1_19
      bool "v1.19"

   config BR2_PACKAGE_BEACON_version_1_0
      bool "v1.0 (IPEX BF2)"

endchoice

config BR2_PACKAGE_BEACON_CONFIG_CUSTOM_VERSION_STR
   string "beacon library version"
   depends on BR2_PACKAGE_BEACON
   depends on BR2_PACKAGE_BEACON_version_custom
   help
      Custom git tag to build.

choice
   prompt "Beacon format"
   default BR2_PACKAGE_BEACON_fmt_1U
   help
      Select the beacon format to use

   config BR2_PACKAGE_BEACON_fmt_Spinnaker3
      bool "Spinnaker3"

   config BR2_PACKAGE_BEACON_fmt_ISX
      bool "ISX"

   config BR2_PACKAGE_BEACON_fmt_lsb
      select BR2_PACKAGE_PSCAM
      bool "LightSail B"

   config BR2_PACKAGE_BEACON_fmt_ExoCube
      bool "ExoCube"

   config BR2_PACKAGE_BEACON_fmt_1U
      bool "Generic 1U"

   config BR2_PACKAGE_BEACON_fmt_ipex1
      bool "IPEX 1"

   config BR2_PACKAGE_BEACON_fmt_ipexbf2
      bool "IPEX Balloon Flight 2"

   config BR2_PACKAGE_BEACON_fmt_ipexbf1
      bool "IPEX Balloon Flight 1"

   config BR2_PACKAGE_BEACON_fmt_ExoCube2
      bool "ExoCube2"

   config BR2_PACKAGE_BEACON_fmt_stub
      bool "Stub (empty) beacon format"

endchoice

config BR2_PACKAGE_BEACON_AUTOTELEM
    bool "Include beacon telemetry in telemetry auto-generation"
    default y
    depends on BR2_PACKAGE_BEACON
    select BR2_PACKAGE_HOST_BEACON
    help
        Include telemetry points from beacon in the telemetry dictionaries
           and configuration files that get generated during the buildroot
           process
```

## package/polysat/beacon/Config.in.host
```kconfig
config BR2_PACKAGE_HOST_BEACON
    bool "beacon"
    select BR2_PACKAGE_HOST_LIBSATPKT
    select BR2_PACKAGE_HOST_LIBPROC
    help
        Process that generates the periodic telemetry beacon.
```

## package/polysat/example_image/Config.in
```kconfig
config BR2_PACKAGE_EXAMPLE_IMAGE
	bool "Create board specific image using the public example git repo"
	help
            Select to create an image using the public example files.
             This uses the example_filesystem.git repo from github for customizations.

choice
   prompt "filesystem version"
   depends on BR2_PACKAGE_EXAMPLE_IMAGE
   default BR2_PACKAGE_EXAMPLE_IMAGE_version_head
   help
      The git version of the file system files to use

   config BR2_PACKAGE_EXAMPLE_IMAGE_version_head
      bool "HEAD"

   config BR2_PACKAGE_EXAMPLE_IMAGE_version_custom
      bool "Manually specify git tag to build"

endchoice

config BR2_PACKAGE_EXAMPLE_IMAGE_CONFIG_CUSTOM_VERSION_STR
   string "Example Image version"
   depends on BR2_PACKAGE_EXAMPLE_IMAGE
   depends on BR2_PACKAGE_EXAMPLE_IMAGE_version_custom
   help
      Custom git tag to build.
```

## package/polysat/fsw_image/Config.in
```kconfig
config BR2_PACKAGE_FSW_IMAGE
	bool "Create a customized FSW image"
	help
            Select to create a custom FSW image using your own git repo.

config BR2_PACKAGE_FSW_IMAGE_CONFIG_GIT_URL
   string "FSW Image GIT URL"
   depends on BR2_PACKAGE_FSW_IMAGE
   default "https://github.com/PolySat/example-image.git"
   help
      Custom git tag to build.

choice
   prompt "filesystem version"
   depends on BR2_PACKAGE_FSW_IMAGE
   default BR2_PACKAGE_FSW_IMAGE_version_head
   help
      The git version of the file system files to use

   config BR2_PACKAGE_FSW_IMAGE_version_head
      bool "HEAD"

   config BR2_PACKAGE_FSW_IMAGE_version_custom
      bool "Manually specify git tag to build"

endchoice

config BR2_PACKAGE_FSW_IMAGE_CONFIG_CUSTOM_VERSION_STR
   string "Example Image version"
   depends on BR2_PACKAGE_FSW_IMAGE
   depends on BR2_PACKAGE_FSW_IMAGE_version_custom
   help
      Custom git tag to build.
```

## package/polysat/ode_image/Config.in
```kconfig
config BR2_PACKAGE_ODE_IMAGE
	bool "Create board specific image for Falcon ODE"
	help
            Select to create an image using the Falcon ODE files.
             This uses the ode-image.git repo from github for customizations.

choice
   prompt "filesystem version"
   depends on BR2_PACKAGE_ODE_IMAGE
   default BR2_PACKAGE_ODE_IMAGE_version_head
   help
      The git version of the file system files to use

   config BR2_PACKAGE_ODE_IMAGE_version_head
      bool "HEAD"

   config BR2_PACKAGE_ODE_IMAGE_version_custom
      bool "Manually specify git tag to build"

endchoice

config BR2_PACKAGE_ODE_IMAGE_CONFIG_CUSTOM_VERSION_STR
   string "ODE Image version"
   depends on BR2_PACKAGE_ODE_IMAGE
   depends on BR2_PACKAGE_ODE_IMAGE_version_custom
   help
      Custom git tag to build.
```

## package/polysat/ode_payload/Config.in
```kconfig
config BR2_PACKAGE_ODE_PAYLOAD
    bool "Falcon ODE payload process"
    select BR2_PACKAGE_LIBSATPKT
    select BR2_PACKAGE_LIBPROC
    select BR2_PACKAGE_LIBGPIO
    help
        Process that manages the Falcon ODE mission payload.

choice
   prompt "version"
   depends on BR2_PACKAGE_ODE_PAYLOAD
   default BR2_PACKAGE_ODE_PAYLOAD_version_1_25
   help
      The git version of the code to use

   config BR2_PACKAGE_ODE_PAYLOAD_version_custom
      bool "Specify a custom git tag"

   config BR2_PACKAGE_ODE_PAYLOAD_version_head
      bool "HEAD"

endchoice

config BR2_PACKAGE_ODE_PAYLOAD_CONFIG_CUSTOM_VERSION_STR
   string "ode_payload process version" 
   depends on BR2_PACKAGE_ODE_PAYLOAD
   depends on BR2_PACKAGE_ODE_PAYLOAD_version_custom
   help 
      Custom git tag to build.
```

## package/polysat/polysat_fsw/Config.in
```kconfig
config BR2_PACKAGE_POLYSAT_FSW
    bool "Core PolySat Flight Software"
    help
        Binaries for PolySat's core flight software

config BR2_PACKAGE_POLYSAT_FSW_CONFIG_VERSION_STR
   string "Core FSW Version"
   depends on BR2_PACKAGE_POLYSAT_FSW
   default "1.0.0"
   help
      The version of the core FSW to install
```

## package/polysat/polysat_fsw/Config.in.host
```kconfig
config BR2_PACKAGE_HOST_POLYSAT_FSW
    bool "Host VM Support for Core PolySat Flight Software"
    help
        Host support for PolySat's core flight software
```

## package/polysat/submodule_image/Config.in
```kconfig
config BR2_PACKAGE_SUBMODULE_IMAGE
	bool "Create image using files from buildroot's parent"
	help
            Select this option when using buildroot as a git submodule
             underneath a repo that contains custom files for your FSW image.
             This option specifically looks in ../rootfs for additional
             files to include in the build.
```

## package/polysat/uvccapture/Config.in
```kconfig
config BR2_PACKAGE_UVCCAPTURE
    bool "uvccapture"
    select BR2_PACKAGE_JPEG
    help
        Process that captures still images from a Video4Linux (v4l) source.

choice
   prompt "uvccapture version"
   depends on BR2_PACKAGE_UVCCAPTURE
   default BR2_PACKAGE_UVCCAPTURE_version_head
   help
      The git version of the uvccapture code to use

   config BR2_PACKAGE_UVCCAPTURE_version_head
      bool "HEAD"

   config BR2_PACKAGE_UVCCAPTURE_version_custom
      bool "Manually specify git tag"

endchoice

config BR2_PACKAGE_UVCCAPTURE_CONFIG_CUSTOM_VERSION_STR
   string "uvccapture version"
   depends on BR2_PACKAGE_UVCCAPTURE
   depends on BR2_PACKAGE_UVCCAPTURE_version_custom
   help
      Custom git tag to build.
```

## package/sourcery-codebench/Config.in.host
```kconfig
config BR2_PACKAGE_HOST_SOURCERY_CODEBENCH
	bool "host Sourcery CodeBench"
	select BR2_PACKAGE_HOST_BZIP2
	help
	  Mentor Graphics Sourcery CodeBench Lite toolchain.

	  http://www.mentor.com/embedded-software/sourcery-tools/sourcery-codebench/overview
```

## target/polysat/cpio/Config.in
```kconfig
config BR2_TARGET_ROOTFS_POLYSAT_CPIO
	bool "cpio the PolySat root filesystem"
	select BR2_HOST_FAKEROOT
	help
	  Build a cpio archive of the PolySat root filesystem

choice
        prompt "Compression method"
        default BR2_TARGET_ROOTFS_POLYSAT_CPIO_NONE
        depends on BR2_TARGET_ROOTFS_POLYSAT_CPIO
        help
          Select compressor for cpio filesystem of the PolySat root filesystem

config BR2_TARGET_ROOTFS_POLYSAT_CPIO_NONE
        bool "no compression"
        help
         Do not compress the PolySat cpio filesystem.

config BR2_TARGET_ROOTFS_POLYSAT_CPIO_GZIP
        bool "gzip"
        help
         Do compress the PolySat cpio filesystem with gzip.
         Note that you either have to have gzip installed on your host
         or select to build a gzip for your host. See the packages submenu.

config BR2_TARGET_ROOTFS_POLYSAT_CPIO_BZIP2
        bool "bzip2"
        help
         Do compress the PolySat cpio filesystem with bzip2.
         Note that you either have to have bzip2 installed on your host
         or select to build a bzip2 for your host. See the packages submenu.

config BR2_TARGET_ROOTFS_POLYSAT_CPIO_LZMA
        bool "lzma"
        help
         Do compress the PolySat cpio filesystem with lzma.
         Note that you either have to have lzma installed on your host
         or select to build a lzma for your host. See the packages submenu.

endchoice

config BR2_TARGET_ROOTFS_POLYSAT_CPIO_COPYTO
	string "also copy the image to..."
	depends on BR2_TARGET_ROOTFS_POLYSAT_CPIO
	default ""
	help
	  Copies the resulting image to a secondary location
	  like a tftp server's root directory.
	
	  Example: $(IMAGE)-$(DATE).polysat.cpio$(CPIO_ROOTFS_COMPRESSOR_EXT)
```

## target/polysat/initrd/Config.in
```kconfig
config BR2_TARGET_ROOTFS_POLYSAT_INITRD
	bool "Generate a PolySat initrd image"
	default n
	select BR2_HOST_FAKEROOT
	help
	  Build an initrd image necessary for PolySat.  This includes
	  all directories *except* /usr/local, which is mounted
	  separately

config BR2_TARGET_ROOTFS_POLYSAT_INITRD_BLOCKS
	int "size in blocks (leave at 0 for auto calculation)"
	depends on BR2_TARGET_ROOTFS_POLYSAT_INITRD
	default 0

config BR2_TARGET_ROOTFS_POLYSAT_INITRD_INODES
	int "inodes (leave at 0 for auto calculation)"
	depends on BR2_TARGET_ROOTFS_POLYSAT_INITRD
	default 0

config BR2_TARGET_ROOTFS_POLYSAT_INITRD_RESBLKS
	int "reserved blocks percentage"
	depends on BR2_TARGET_ROOTFS_POLYSAT_INITRD
	default 0

config BR2_TARGET_ROOTFS_POLYSAT_INITRD_SQUASH
	bool "Make all files be owned by root"
	depends on  BR2_TARGET_ROOTFS_POLYSAT_INITRD
	default y

config BR2_TARGET_ROOTFS_POLYSAT_INITRD_OUTPUT
	string "Output File"
	depends on BR2_TARGET_ROOTFS_POLYSAT_INITRD
	default "$(IMAGE).polysat-initrd"

config BR2_TARGET_ROOTFS_POLYSAT_INITRD_COPYTO
	string "also copy the image to..."
	depends on BR2_TARGET_ROOTFS_POLYSAT_INITRD
	default ""
	help
	  Copies the resulting image to a secondary location
	  like a tftp server's root directory.
```
